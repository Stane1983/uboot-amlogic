## drivers/amlogic/crypto/Kconfig
```kconfig
config AML_CRYPTO_64
	tristate "Amlogic Crypto driver 64 bits mode"
	default n
	depends on AML_CRYPTO
	help
	  Support Amlogic Crypto driver 64 bits mode

	  64 bits Crypto driver for Amlogic DMA device
config AML_CRYPTO
	tristate "Amlogic Crypto driver"
	default n
	help
	  Amlogic Crypto driver

	  Crypto driver for Amlogic DMA device
```

## drivers/amlogic/efuse/Kconfig
```kconfig
config EFUSE_MRK_GET_CHECKNUM
	bool "efuse get MRK checksum support"
	default y
	help
	  Enable command for get MRK checksum

config EFUSE_AUDIO_ID_CHECKNUM
	bool "efuse get customer audio id checksum support"
	default y
	help
	  Enable command for get customer audio id checksum
```

## drivers/amlogic/image_check/Kconfig
```kconfig
config IMAGE_CHECK
	bool "AML IMAGE CHECK Support"
	default y
	select AML_CRYPTO
	help
	  Enable support for the Amlogic image check.
```

## drivers/amlogic/leds/Kconfig
```kconfig
config MESON_LEDS_STATE_CONTROL
    bool "Amlogic device LEDS control"
    default n
config CMD_LED_DISPLAY
    bool "Amlogic device LED_DISPLAY"
    default n
```

## drivers/amlogic/log/Kconfig
```kconfig
config SAVE_UBOOT_LOG
	tristate "save log support for Amlogic"
	default n
	help
	  Amlogic save log driver

	  Provide save log in ddr and kernel get log from ddr,
	  log buffer is loop.
```

## drivers/amlogic/media/Kconfig
```kconfig
config AML_MEDIA
	bool "AML Media drivers Support"
	help
	  Enable support for the Amlogic Media drivers.

config AML_VOUT
	bool "Driver support for video output"
	help
	  Enable support for amlogic video output
	  lcd,cvbs,hdmitx

source "drivers/amlogic/media/common/Kconfig"

source "drivers/amlogic/media/vout/Kconfig"
```

## drivers/amlogic/media/common/Kconfig
```kconfig
config AML_VPP
	bool "AML VPP drivers Support"
	help
	  Enable support for the Amlogic VPP drivers.

source "drivers/amlogic/media/common/vpu/Kconfig"
source "drivers/amlogic/media/common/vpp/Kconfig"
```

## drivers/amlogic/media/common/jpeg/Kconfig
```kconfig
config AML_JPEG
	bool "AML JPEG drivers Support"
	help
	  Enable support for the Amlogic JPEG drivers.
```

## drivers/amlogic/media/vout/DisplayPort/Kconfig
```kconfig
menu "AMLOGIC DisplayPort Drivers"

config AML_DisplayPort_TX
	bool "DisplayPort/eDP output"
	depends on AML_VOUT
	help
	  Support for DisplayPort/eDP output

endmenu
```

## drivers/amlogic/media/vout/Kconfig
```kconfig
source "drivers/amlogic/media/vout/cvbs/Kconfig"

source "drivers/amlogic/media/vout/lcd/Kconfig"

source "drivers/amlogic/media/vout/hdmitx/Kconfig"
```

## drivers/amlogic/media/vout/eDPTX/Kconfig
```kconfig
menu "AMLOGIC eDP TX Drivers"

config AML_eDPTX
	bool "eDP tx output"
	depends on AML_VOUT
	help
	  Support for eDP output
	  need lcd backlight support

endmenu
```

## drivers/amlogic/media/vout/hdmitx/hdmitx_common/Kconfig
```kconfig
#
# HDMITX Common
#
config AML_HDMITX_COMMON
	bool "AML_HDMITX_COMMON drivers Support"
	depends on AML_HDMITX
	help
		HDMITX_COMMON Output Enable
```

## drivers/amlogic/media/vout/lcd/Kconfig
```kconfig
menu "AMLOGIC LCD Drivers"

config AML_LCD
	bool "lcd output for video"
	depends on AML_VOUT
	help
	  Support for lcd video output

config AML_LCD_DPI
	bool "DPI output for lcd"
	depends on AML_LCD
	help
	  Support for lcd DPI output (rgb, bt656, bt2020)
	  Disable to reduce size on chip without DPI

config AML_LCD_LVDS
	bool "LVDS output for lcd"
	depends on AML_LCD
	help
	  Support for lcd LVDS output
	  Disable to reduce size on chip without LVDS

config AML_LCD_VBYONE
	bool "V-BY-ONE output for lcd"
	depends on AML_LCD
	help
	  Support for lcd V-BY-ONE output

config AML_LCD_TCON
	bool "tcon output for lcd"
	depends on AML_LCD
	help
	  Support for lcd tcon output

config AML_LCD_MIPI_DSI
	bool "MIPI-DSI output for lcd"
	depends on AML_LCD
	help
	  Support for lcd MIPI-DSI output

source "drivers/amlogic/media/vout/lcd/lcd_parser/Kconfig"
source "drivers/amlogic/media/vout/lcd/lcd_extern/Kconfig"
source "drivers/amlogic/media/vout/lcd/backlight/Kconfig"

endmenu
```

## drivers/amlogic/media/vout/lcd/lcd_parser/Kconfig
```kconfig
config AML_LCD_JSON
	bool "lcd json parse for lcd"
	depends on AML_LCD
	help
	  Support for lcd json parameter parse
```

## drivers/amlogic/mtd/Kconfig
```kconfig
config AML_MTD
	bool "support AML MTD for Raw NAND or SPI NAND or SPI NOR"
	default y if MESON_NFC || MTD_SPI_NAND || SPI_FLASH_MTD
	help
		This option, if enabled, support for AML MTD

config AML_MTDPART
	bool "support AML MTD partition for raw NAND or SPI nand or SPI NOR"
	default y if AML_MTD
	help
		This option, if enabled, support for AML MTD partition

source "drivers/amlogic/mtd/nand/spi/Kconfig"

source "drivers/amlogic/mtd/nand/raw/Kconfig"
```

## drivers/amlogic/mtd/nand/raw/Kconfig
```kconfig
config MESON_NFC
	bool "Support for NAND on Amlogic SoCs"
	depends on ARCH_MESON && MTD
    select SYS_NAND_SELF_INIT
	help
		This option, if enabled, support for MESON Nand flash controller.
```

## drivers/amlogic/pci/Kconfig
```kconfig
menu "AMLOGIC PCI POWER Support"

config AMLOGIC_PCI_POWER
	bool "Uboot standby Support"
	help
	  If need.
	  Please set it to Y
	  for
	  amlogic chip.

endmenu
```

## drivers/amlogic/pinctrl/Kconfig
```kconfig
if ARCH_MESON

config PINCTRL_MESON_S4
	bool "Amlogic Meson S4 SoC pinctrl driver"
	select PINCTRL_MESON_AXG_PMX

config PINCTRL_MESON_A4
	bool "Amlogic Meson A4 SoC pinctrl driver"
	select PINCTRL_MESON_AXG_PMX

config PINCTRL_MESON_S1A
	bool "Amlogic Meson S1A SoC pinctrl driver"
	select PINCTRL_MESON_AXG_PMX

config PINCTRL_MESON_S7
	bool "Amlogic Meson S7 SoC pinctrl driver"
	select PINCTRL_MESON_AXG_PMX

config PINCTRL_MESON_T6D
	bool "Amlogic Meson T6D SoC pinctrl driver"
	select PINCTRL_MESON_AXG_PMX

config PINCTRL_MESON_T5M
	bool "Amlogic Meson T5M SoC pinctrl driver"
	select PINCTRL_MESON_AXG_PMX

config PINCTRL_MESON_S7D
	bool "Amlogic Meson S7D SoC pinctrl driver"
	select PINCTRL_MESON_AXG_PMX

config PINCTRL_MESON_S6
	bool "Amlogic Meson S6 SoC pinctrl driver"
	select PINCTRL_MESON_AXG_PMX

endif
```

## drivers/amlogic/spi/Kconfig
```kconfig
if DM_SPI

config AML_SPIFC
        bool "Amlogic SPIFC Driver"
        help
          Enable support for SPI Flash Controller on meson SoCs.
          It should be set when user want SPI NAND or SPI NOR on meson SoCs.
          If SPI NAND/SPI FLASH is enabled, please open it in defconfig

config AML_SPIFCV2
        bool "Amlogic SPIFC_V2 Driver"
        help
          Enable support for SPI Flash Controller v2 on a1 meson SoCs.
          It should be set when user want SPI NAND or SPI NOR on a1 meson SoCs.
          If SPI NAND/SPI FLASH is enabled, please open it in defconfig

endif
```

## drivers/amlogic/st7789v3/Kconfig
```kconfig
config ST7789V3_SPI_LCD
    bool "ST7789V3_SPI_LCD"
    help
        Enable support for st7789v3 spi lcd driver.
```

## drivers/amlogic/usb/Kconfig
```kconfig
menu "AMLOGIC USB Drivers"

config AMLOGIC_USB
	bool "the CONFIG_AMLOGIC_USB is used to mark our own modifications"
	depends on USB
	---help---
	  Say Y here if you want to use Amlogic usb.

if AMLOGIC_USB

config USB_XHCI_CRG
        bool "Corgine USB3 DRD Core Support"
		depends on USB_XHCI_HCD
        help
          Say Y or if your system has a Dual Role SuperSpeed
          USB controller based on the Corgine USB3 IP Core.

config AMLOGIC_USB2_PHY
	bool "amlogic PHY2 support"
	depends on PHY
	help
	  This select a amlogic PHY2 driver.

config AMLOGIC_USB3_PHY
	bool "amlogic PHY3 support"
	depends on PHY
	help
	  This select a amlogic PHY3 driver.

if USB_GADGET
config USB_DEVICE_V2
	bool

config USB_GADGET_CRG
	bool "fastboot corgine usb driver support"
	help
	  Say Y if the controller of the usb device is crg.
	  Say N if the controller of the usb device is dwc_otg.

config FASTBOOT_DWC_PCD
	bool "fastboot usb driver support"
	select USB_DEVICE_V2
	select USB_GADGET_DUALSPEED

endif

endif

endmenu
```
