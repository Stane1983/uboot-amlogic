## drivers/amlogic/watchdog/Kconfig
```kconfig
config WDT_MESON
	bool "Amlogic Meson watchdog timer support"
	depends on WDT
	help
	   Select this to enable Amlogic Meson watchdog timer, which can be
	   found on some Amlogic Meson chips.
```

## drivers/amlogic/watchkey/Kconfig
```kconfig
config AMLOGIC_WATCHKEY
	bool "Amlogic watch key device support"
	default n
	help
	  Watch-Key driver can monitor the status of keys from
	  the beginning of power-on.
```

## drivers/amlogic/wifi/Kconfig
```kconfig
config AMLOGIC_WIFI_USB2T
	tristate "Support for Amlogic USB 2T WIFI"
	default n
	help
	  Amlogic wifi usb 2t driver
```

## drivers/amlogic/wireless/Kconfig
```kconfig
config AMLOGIC_WIFI_USB2T
	bool "Support for Amlogic USB 2T WIFI"
	default n
	help
	  Amlogic wifi usb 2t driver
	  If usb wifi usb 2t driver, enable y

config AMLOGIC_BT_USB
	bool "Support for Amlogic usb bt init and config wakeup parameters"
	default n
	help
	  Amlogic usb bt init and config wakeup parameters
```

## drivers/clk/meson/Kconfig
```kconfig
config CLK_MESON_GX
	bool "Enable clock support for Amlogic GX"
	depends on CLK && ARCH_MESON
	default MESON_GX
	help
	  Enable clock support for the Amlogic GX SoC family, such as
	  the S905, S905X/D and S912.

config CLK_MESON_AXG
	bool "Enable clock support for Amlogic AXG"
	depends on CLK && ARCH_MESON
	default MESON_AXG
	help
	  Enable clock support for the Amlogic AXG SoC family, such as
	  the A113X/D

config CLK_MESON_G12A
	bool "Enable clock support for Amlogic G12A"
	depends on CLK && ARCH_MESON
	default MESON_G12A
	help
	  Enable clock support for the Amlogic G12A SoC family, such as
	  the S905X/D2

config CLK_MESON_S4
        bool "Support S4 Clock"
        depends on CLK
        help
                This option is used to enable the meson s4 clock
                driver
```

## drivers/usb/gadget/v2_burning/Kconfig
```kconfig
#
# USB burning
#

menuconfig AML_V2_FACTORY_BURN
	bool "Amlogic V2 burning Support"
	---help---
	  Say Y here if you want to support amlogic factory burning

if AML_V2_FACTORY_BURN

config AML_FACTORY_BURN_LOCAL_UPGRADE
	bool "AML factory burning support local sdcard and usb disk"
	---help---
	  Say Y here if you want to support upgrade from sdcard and usb disk

config SUPPORT_SDC_KEYBURN
    bool "burn keys in sdc_burn or usb_burn"
    default y
    depends on AML_FACTORY_BURN_LOCAL_UPGRADE

config SD_BURNING_SUPPORT_UI
	depends on CMD_BMP
	bool "AML factory sdcard and usb disk with UI progress info"
	---help---
	  Say Y here if you want to support sdcard and usb disk with UI progress info

endif # AML_V2_FACTORY_BURN
```

## drivers/usb/gadget/v3_burning/Kconfig
```kconfig
#
# AML V3 burning
#
menuconfig AML_V3_FACTORY_BURN
	bool "Amlogic V3 burning Support"
	depends on AML_STORE_WRAPPER
	---help---
	  Say Y here if you want to support amlogic V3 factory burning

if AML_V3_FACTORY_BURN

config AML_NO_USB_MODULE
    bool "bl33 without full usb function"
    default n

config AML_V3_USB_TOOl
	bool "DNL USB burning support"
	select USB_GADGET_DOWNLOAD
	select FASTBOOT_DWC_PCD #for fastboot/dwc_pcd.o fastboot/dwc_pcd_irq.o
	depends on USB_GADGET
	---help---
	  Say Y here if you want to update firmware by aml DNL tool

config V3_USB_BURN_FULL_SPEED
    depends on AML_V3_USB_TOOl
    bool "usb burning driver runing on Full-speed mode"
    default n
	---help---
	  Change Y Only when u testing on usb or FS mode have problem

config V3_KEY_BURNING_SUPPORT
	depends on UNIFY_KEY_MANAGE
	bool "support burning unifykey in v3 burning"
	default y
	select AML_V2_FACTORY_BURN

config NAND_BL2_VALID_NUM
	prompt "nand bl2/bl2e/bl2x/ddrfip valid num"
	int
	default -1

config NAND_TPL_VALID_NUM
	prompt "nand TPL/devfip valid num"
	int
	default -1

config DISCRETE_BOOTLOADER_NEW
	bool "handle discrte bootloader inside flash driver"
	default y

config ADNL_FORCE_BL1_IF_SCS
    depends on AML_V3_USB_TOOl
    bool
    default n
	help
	    uboot adnl will force enter rom/bl1 usb mode
	    if connect to pc and secure boot

endif #AML_V3_FACTORY_BURN
```
