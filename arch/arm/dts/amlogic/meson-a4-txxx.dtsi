// SPDX-License-Identifier: (GPL-2.0+ OR MIT)
/*
 * Copyright (c) 2019 Amlogic, Inc. All rights reserved.
 */

#include "amlogic/meson-a4.dtsi"
#include "amlogic/meson-a4-mali.dtsi"

/ {
	compatible = "amlogic,txxx", "amlogic,meson-a4";
};

&ethmac {
	phy-mode = "rmii";
//	phy-handle = <&external_phy>;
};
