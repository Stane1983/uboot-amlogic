// SPDX-License-Identifier: (GPL-2.0+ OR MIT)
/*
 * Copyright (c) 2019 Amlogic, Inc. All rights reserved.
 */

#include "amlogic/meson-t6d.dtsi"
#include "amlogic/meson-t6d-mali.dtsi"

/ {
	compatible = "amlogic,txxx", "amlogic,meson-t6d";
};

&ethmac {
	phy-mode = "rmii";
//	phy-handle = <&external_phy>;
};
