// SPDX-License-Identifier: (GPL-2.0+ OR MIT)
/*
 * Copyright (c) 2019 Amlogic, Inc. All rights reserved.
 */

#include "amlogic/meson-s6.dtsi"
#include "amlogic/meson-s6-mali.dtsi"

/ {
	compatible = "amlogic,txxx", "amlogic,meson-s6";
};

