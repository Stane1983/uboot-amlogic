// SPDX-License-Identifier: (GPL-2.0+ OR MIT)
/*
 * Copyright (c) 2019 Amlogic, Inc. All rights reserved.
 */

#include "amlogic/meson-t6x.dtsi"
#include "amlogic/meson-t6x-mali.dtsi"

/ {
	compatible = "amlogic,txxx", "amlogic,meson-t6x";
};

&ethmac {
	phy-mode = "rmii";
//	phy-handle = <&external_phy>;
};
