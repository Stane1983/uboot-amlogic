## configs/amlogic/s7_bh202_defconfig
```kconfig
CONFIG_ARM=y
CONFIG_ARCH_MESON=y
CONFIG_DM_GPIO=y
CONFIG_DEFAULT_DEVICE_TREE="meson-s7-bh202"
CONFIG_SYS_PROMPT="s7_bh202# "
CONFIG_MESON_S7=y
CONFIG_AMLOGIC_MODIFY=y
CONFIG_PXP_AOCPU=y
CONFIG_SECURE_POWER_CONTROL=y
CONFIG_AML_TSENSOR=y
CONFIG_AML_TSENSOR_COOL=y
CONFIG_KEY_PRESERVE=y
CONFIG_AMLOGIC_ETH=y
CONFIG_AMLOGIC_EMMC=y
CONFIG_S7_BH202=y
CONFIG_CMD_ADTIMG=y
CONFIG_DEBUG_UART_BASE=0xfe07a000
CONFIG_DEBUG_UART_CLOCK=24000000
CONFIG_ARMV8_CRYPTO=y
CONFIG_DEBUG_UART=y
CONFIG_OF_BOARD_SETUP=y
CONFIG_BOOTCOMMAND="run storeboot"
CONFIG_USE_PREBOOT=y
CONFIG_SILENT_CONSOLE=y
# CONFIG_DISPLAY_CPUINFO is not set
# CONFIG_DISPLAY_BOARDINFO is not set
CONFIG_BOARD_LATE_INIT=y
# CONFIG_CMD_BDI is not set
# CONFIG_CMD_IMI is not set
CONFIG_CMD_CLK=y
CONFIG_CMD_GPIO=y
CONFIG_CMD_I2C=y
# CONFIG_CMD_LOADB is not set
# CONFIG_CMD_LOADS is not set
CONFIG_CMD_MMC=y
CONFIG_CMD_MTD=y
CONFIG_CMD_NAND=y
CONFIG_AML_STORAGE=y
CONFIG_CMD_USB=y
CONFIG_CMD_WDT=y
# CONFIG_CMD_SETEXPR is not set
CONFIG_CMD_CACHE=y
CONFIG_CMD_MTDPARTS=y
CONFIG_AML_STORAGE=y
CONFIG_CMD_BOOTCTOL_AVB=y
CONFIG_CMD_BMP=y
CONFIG_CMD_CLKMSR=y
CONFIG_CMD_SARADC=y
CONFIG_CMD_JTAG=y
CONFIG_CMD_IR=y
CONFIG_CMD_INI=y
CONFIG_AML_PARTITION=y
CONFIG_OF_CONTROL=y
CONFIG_OF_EMBED=y
CONFIG_ENV_SOURCE_FILE="../env/android_ott"
CONFIG_ENV_IS_IN_STORAGE=y
CONFIG_EFUSE=y
CONFIG_ADC=y
CONFIG_CLK=y
CONFIG_USB_FUNCTION_FASTBOOT=y
CONFIG_FASTBOOT_FLASH=y
CONFIG_FASTBOOT_FLASH_MMC_DEV=1
CONFIG_DM_I2C=y
CONFIG_SYS_I2C_MESON=y
CONFIG_MISC=y
CONFIG_MMC_HS200_SUPPORT=y
CONFIG_MMC_MESON_GX=y
CONFIG_MTD=y
CONFIG_DM_MTD=y
CONFIG_MTD_RAW_NAND=y
CONFIG_SYS_MAX_NAND_DEVICE=2
CONFIG_DM_SPI_FLASH=y
CONFIG_SPI_FLASH_GIGADEVICE=y
CONFIG_SPI_FLASH_MACRONIX=y
CONFIG_SPI_FLASH_WINBOND=y
CONFIG_SPI_FLASH_MTD=y
CONFIG_PHYLIB=y
CONFIG_PHY=y
CONFIG_PINCTRL=y
CONFIG_DM_REGULATOR=y
CONFIG_DM_PWM=y
CONFIG_PWM_MESON=y
CONFIG_DEBUG_UART_ANNOUNCE=y
CONFIG_DEBUG_UART_SKIP_INIT=y
CONFIG_MESON_SERIAL=y
CONFIG_SPI=y
CONFIG_DM_SPI=y
CONFIG_TEE=y
CONFIG_OPTEE=y
CONFIG_USB=y
CONFIG_USB_XHCI_HCD=y
CONFIG_USB_GADGET=y
CONFIG_AML_FACTORY_BURN_LOCAL_UPGRADE=y
CONFIG_SD_BURNING_SUPPORT_UI=y
CONFIG_AML_V3_FACTORY_BURN=y
CONFIG_AML_V3_USB_TOOl=y
# CONFIG_WATCHDOG_AUTOSTART is not set
CONFIG_WDT=y
CONFIG_AML_DRIVER=y
CONFIG_AML_MEDIA=y
CONFIG_AML_VOUT=y
CONFIG_AML_OSD=y
CONFIG_AML_VPP=y
CONFIG_AML_VPU=y
CONFIG_AML_HDMITX=y
CONFIG_AML_HDMITX21=y
CONFIG_AML_CVBS=y
CONFIG_UNIFY_KEY_MANAGE=y
CONFIG_SECURE_STORAGE=y
CONFIG_MESON_LEDS_STATE_CONTROL=y
CONFIG_PHY_AMLOGIC=y
CONFIG_PINCTRL_MESON_S7=y
CONFIG_MESON_NFC=y
CONFIG_AMLOGIC_USB=y
CONFIG_USB_XHCI_CRG=y
CONFIG_AMLOGIC_USB2_PHY=y
CONFIG_AMLOGIC_USB3_PHY=y
CONFIG_USB_GADGET_CRG=y
CONFIG_WDT_MESON=y
CONFIG_SARADC_MESON_G12A=y
CONFIG_XBC=y
CONFIG_SHA1=y
CONFIG_LMB_MAX_REGIONS=9
CONFIG_OF_LIBFDT_OVERLAY=y
CONFIG_CMD_SCMI_SHMEM_ADDR=y
```

## drivers/amlogic/Kconfig
```kconfig
menu "AMLOGIC Drivers"

config AML_DRIVER
	bool "AML drivers Support"
	help
	  Enable support for the Amlogic drivers.

source "drivers/amlogic/media/Kconfig"

source "drivers/amlogic/keymanage/Kconfig"

source "drivers/amlogic/storagekey/Kconfig"

source "drivers/amlogic/power/Kconfig"

source "drivers/amlogic/provision/Kconfig"

source "drivers/amlogic/leds/Kconfig"

source "drivers/amlogic/ir/Kconfig"

source "drivers/amlogic/tee/Kconfig"

source "drivers/amlogic/crypto/Kconfig"

source "drivers/amlogic/mkl/Kconfig"

source "drivers/amlogic/mmc/Kconfig"

source "drivers/amlogic/efuse/Kconfig"

source "drivers/amlogic/pinctrl/Kconfig"

source "drivers/amlogic/spi/Kconfig"

source "drivers/amlogic/usb/Kconfig"

source "drivers/amlogic/watchdog/Kconfig"

source "drivers/amlogic/adc/Kconfig"

endmenu
```

## drivers/amlogic/adc/Kconfig
```kconfig
config SARADC_AMLOGIC
	bool
	imply REGMAP

config SARADC_MESON_G12A
	bool "Enable Amlogic Meson-G12A SARADC driver"
	select SARADC_AMLOGIC
	help
	  This enables driver for Amlogic Meson-G12A SARADC.
	  It provides:
	  - 8 analog input channels
	  - 1O or 12 bits resolution
	  - Up to 1MSPS of sample rate

config SARADC_MESON_C2
	bool "Enable Amlogic Meson-C2 SARADC driver"
	select SARADC_AMLOGIC
	help
	  This enables driver for Amlogic Meson-C2 SARADC.
	  It provides:
	  - 8 analog input channels
	  - 1O or 12 bits resolution
	  - Up to 1MSPS of sample rate

config AMLOGIC_SARADC
	bool "Enable Amlogic SARADC driver"
	select SARADC_AMLOGIC
	help
	  This enables driver for Amlogic SARADC.
```

## drivers/amlogic/amfc/Kconfig
```kconfig
config AMLOGIC_AMFC
	tristate "Amlogic AMFC driver"
	default n
	help
	  Amlogic AMFC driver

	  Hardware compress/decompress module
```

## drivers/amlogic/clock/Kconfig
```kconfig
config CLK_MESON_S4
	bool "Enable clock support for Amlogic S4"
	depends on CLK && ARCH_MESON
	default MESON_S4
	help
	  Enable clock support for the Amlogic S4 SoC family, such as
	  the S905Y4

config CLK_MESON_A4
	bool "Enable clock support for Amlogic A4"
	depends on CLK && ARCH_MESON
	default MESON_A4
	help
	  Enable clock support for the Amlogic A4 SoC family, such as
	  the A113L2

config CLK_MESON_S1A
	bool "Enable clock support for Amlogic S1A"
	depends on CLK && ARCH_MESON
	default MESON_S1A
	help
	  Enable clock support for the Amlogic S1A SoC family

config CLK_MESON_S7
	bool "Enable clock support for Amlogic S7"
	depends on CLK && ARCH_MESON
	default MESON_S7
	help
	  Enable clock support for the Amlogic S7 SoC family, such as
	  the SKT

config CLK_MESON_T6D
	bool "Enable clock support for Amlogic T6D"
	depends on CLK && ARCH_MESON
	default MESON_T6D
	help
	  Enable clock support for the Amlogic T6D SoC family

config CLK_MESON_T5M
	bool "Enable clock support for Amlogic T5M"
	depends on CLK && ARCH_MESON
	default MESON_T5M
	help
	  Enable clock support for the Amlogic T5M SoC family

config CLK_MESON_S7D
	bool "Enable clock support for Amlogic S7D"
	depends on CLK && ARCH_MESON
	default MESON_S7D
	help
	  Enable clock support for the Amlogic S7D SoC family, such as
	  the SKT

config CLK_MESON_S6
	bool "Enable clock support for Amlogic S6"
	depends on CLK && ARCH_MESON
	default MESON_S6
	help
	  Enable clock support for the Amlogic S6 SoC family, such as
	  the SKT
```
