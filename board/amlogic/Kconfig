## board/amlogic/s1a_bg209/Kconfig
```kconfig
if TARGET_S1A_BG209

config SYS_SOC
	default "s1a"

config SYS_BOARD
	default "s1a_bg209"

config SYS_CONFIG_NAME
	default "s1a_bg209"

config DTB_BIND_KERNEL
    bool "load dtb from boot part but not flash rsv"
    default n

config CMD_PLLTEST
	bool "support plltest command"
	default n
	help
	  support plltest command

config AML_REBOOT
       bool "reboot cmd"
       default y
       help
         support uboot reboot cmd
endif
```

## board/amlogic/s1a_bg209_s805c1eng/Kconfig
```kconfig
if TARGET_S1A_BG209_S805C1ENG

config SYS_SOC
	default "s1a"

config SYS_BOARD
	default "s1a_bg209_s805c1eng"

config SYS_CONFIG_NAME
	default "s1a_bg209_s805c1eng"

config DTB_BIND_KERNEL
    bool "load dtb from boot part but not flash rsv"
    default n

config CMD_PLLTEST
	bool "support plltest command"
	default n
	help
	  support plltest command

config AML_REBOOT
       bool "reboot cmd"
       default y
       help
         support uboot reboot cmd
endif
```

## board/amlogic/s6_bl201/Kconfig
```kconfig
if TARGET_S6_BL201

config SYS_SOC
	default "s6"

config SYS_BOARD
	default "s6_bl201"

config SYS_CONFIG_NAME
	default "s6_bl201"

config BL30_SELECT
	string "s6 BL30 board config"
	default "s6_bl201"

config DTB_BIND_KERNEL
    bool "load dtb from boot part but not flash rsv"
    default n

config CMD_PLLTEST
        bool "support plltest command"
        default n
		help
			support plltest command

config AML_REBOOT
		bool "reboot cmd"
		default y
		help
			support uboot reboot cmd

config ENABLE_AML_GPIO_UPGRADE
	bool "upgrade key check"
	default n

config AML_GPIO_UPGRADE_KEY
	string "gpio key"
	default ""
endif
```

## board/amlogic/s6_bl204/Kconfig
```kconfig
if TARGET_S6_BL204

config SYS_SOC
	default "s6"

config SYS_BOARD
	default "s6_bl204"

config SYS_CONFIG_NAME
	default "s6_bl204"

config BL30_SELECT
	string "s6 BL30 board config"
	default "s6_bl204"

config DTB_BIND_KERNEL
    bool "load dtb from boot part but not flash rsv"
    default n

config CMD_PLLTEST
        bool "support plltest command"
        default n
		help
			support plltest command

config AML_REBOOT
		bool "reboot cmd"
		default y
		help
			support uboot reboot cmd

config ENABLE_AML_GPIO_UPGRADE
	bool "upgrade key check"
	default n

config AML_GPIO_UPGRADE_KEY
	string "gpio key"
	default ""
endif
```

## board/amlogic/s6_bq209/Kconfig
```kconfig
if TARGET_S6_BQ209

config SYS_SOC
	default "s6"

config SYS_BOARD
	default "s6_bq209"

config SYS_CONFIG_NAME
	default "s6_bq209"

config BL30_SELECT
	string "s6 BL30 board config"
	default "s6_bq209"

config DTB_BIND_KERNEL
    bool "load dtb from boot part but not flash rsv"
    default n

config CMD_PLLTEST
        bool "support plltest command"
        default n
		help
			support plltest command

config AML_REBOOT
		bool "reboot cmd"
		default y
		help
			support uboot reboot cmd
endif
```

## board/amlogic/s6_skt/Kconfig
```kconfig
if TARGET_S6_SKT

config SYS_SOC
	default "s6"

config SYS_BOARD
	default "s6_skt"

config SYS_CONFIG_NAME
	default "s6_skt"

config DTB_BIND_KERNEL
    bool "load dtb from boot part but not flash rsv"
    default n

config CMD_PLLTEST
        bool "support plltest command"
        default n
		help
			support plltest command

config AML_REBOOT
		bool "reboot cmd"
		default y
		help
			support uboot reboot cmd
endif
```

## board/amlogic/s7_bh202/Kconfig
```kconfig
if TARGET_S7_BH202

config SYS_SOC
	default "s7"

config SYS_BOARD
	default "s7_bh202"

config SYS_CONFIG_NAME
	default "s7_bh202"

config DTB_BIND_KERNEL
    bool "load dtb from boot part but not flash rsv"
    default n

config BL30_SELECT
	string "s7 BL30 board config"
		default "s7_bh202"

config CMD_PLLTEST
        bool "support plltest command"
        default n
		help
			support plltest command

config AML_REBOOT
		bool "reboot cmd"
		default y
		help
			support uboot reboot cmd
endif
```

## board/amlogic/s7_bp201/Kconfig
```kconfig
if TARGET_S7_BP201

config SYS_SOC
	default "s7"

config SYS_BOARD
	default "s7_bp201"

config SYS_CONFIG_NAME
	default "s7_bp201"

config DTB_BIND_KERNEL
    bool "load dtb from boot part but not flash rsv"
    default n

config BL30_SELECT
	string "s7 BL30 board config"
		default "s7_bp201"

config CMD_PLLTEST
        bool "support plltest command"
        default n
		help
			support plltest command

config AML_REBOOT
		bool "reboot cmd"
		default y
		help
			support uboot reboot cmd

config ENABLE_AML_GPIO_UPGRADE
    bool "upgrade key check"
    default n

config AML_GPIO_UPGRADE_KEY
    string "gpio key"
    default ""
endif
```

## board/amlogic/s7d_bm209/Kconfig
```kconfig
if TARGET_S7D_BM209

config SYS_SOC
	default "s7d"

config SYS_BOARD
	default "s7d_bm209"

config SYS_CONFIG_NAME
	default "s7d_bm209"

config DTB_BIND_KERNEL
    bool "load dtb from boot part but not flash rsv"
    default n
config BL30_SELECT
	string "s7d BL30 board config"
		default "s7d_bm209"
config CMD_PLLTEST
        bool "support plltest command"
        default n
		help
			support plltest command

config AML_REBOOT
		bool "reboot cmd"
		default y
		help
			support uboot reboot cmd

config ENABLE_AML_GPIO_UPGRADE
    bool "upgrade key check"
    default n

config AML_GPIO_UPGRADE_KEY
    string "gpio key"
    default ""

endif
```

## board/amlogic/s7d_skt/Kconfig
```kconfig
if TARGET_S7D_SKT

config SYS_SOC
	default "s7d"

config SYS_BOARD
	default "s7d_skt"

config SYS_CONFIG_NAME
	default "s7d_skt"

config DTB_BIND_KERNEL
    bool "load dtb from boot part but not flash rsv"
    default n
config BL30_SELECT
	string "s7d BL30 board config"
		default "s7d_pxp"
config CMD_PLLTEST
        bool "support plltest command"
        default n
		help
			support plltest command

config AML_REBOOT
		bool "reboot cmd"
		default y
		help
			support uboot reboot cmd
endif
```

## board/amlogic/s7d_t232/Kconfig
```kconfig
if TARGET_S7D_T232

config SYS_SOC
	default "s7d"

config SYS_BOARD
	default "s7d_t232"

config SYS_CONFIG_NAME
	default "s7d_t232"

config DTB_BIND_KERNEL
    bool "load dtb from boot part but not flash rsv"
    default n
config BL30_SELECT
	string "s7d BL30 board config"
		default "s7d_t232"
config CMD_PLLTEST
        bool "support plltest command"
        default n
		help
			support plltest command

config AML_REBOOT
		bool "reboot cmd"
		default y
		help
			support uboot reboot cmd

config ENABLE_AML_GPIO_UPGRADE
    bool "upgrade key check"
    default n

config AML_GPIO_UPGRADE_KEY
    string "gpio key"
    default ""

endif
```

## board/amlogic/t3_t982/Kconfig
```kconfig
if TARGET_T3_T982

config SYS_SOC
	default "t3"

config SYS_BOARD
	default "t3_t982"

config SYS_VENDOR
	default "amlogic"

config SYS_CONFIG_NAME
	default "t3_t982"

config DTB_BIND_KERNEL
    bool "load dtb from boot part but not flash rsv"
    default n

config AML_REBOOT
       bool "reboot cmd"
       default y
       help
         support uboot reboot cmd

config VBYONE_OUTPUT
    bool "set t982 output is vbyone"
    default n

config ENABLE_HIBERNATION
    bool "enable hibernation feature"
    default n

endif
```

## board/amlogic/t6d_br301/Kconfig
```kconfig
if TARGET_T6D_BR301

config SYS_SOC
	default "t6d"

config SYS_BOARD
	default "t6d_br301"

config SYS_CONFIG_NAME
	default "t6d_br301"

config DTB_BIND_KERNEL
    bool "load dtb from boot part but not flash rsv"
    default n

config BL30_SELECT
    string "t6d BL30 board config"
        default "t6d_br301"

config CMD_PLLTEST
        bool "support plltest command"
        default n
        help
            support plltest command

config AML_REBOOT
        bool "reboot cmd"
        default y
        help
            support uboot reboot cmd
endif
```

## board/amlogic/t6d_br309/Kconfig
```kconfig
if TARGET_T6D_BR309

config SYS_SOC
    default "t6d"

config SYS_BOARD
    default "t6d_br309"

config SYS_CONFIG_NAME
    default "t6d_br309"

config DTB_BIND_KERNEL
    bool "load dtb from boot part but not flash rsv"
    default n

config BL30_SELECT
    string "t6d BL30 board config"
    default "t6d_br309"

config CMD_PLLTEST
        bool "support plltest command"
        default n
        help
           support plltest command

config AML_REBOOT
        bool "reboot cmd"
        default y
        help
           support uboot reboot cmd
endif
```

## board/amlogic/t6d_skt/Kconfig
```kconfig
if TARGET_T6D_SKT

config SYS_SOC
	default "t6d"

config SYS_BOARD
	default "t6d_skt"

config SYS_CONFIG_NAME
	default "t6d_skt"

config DTB_BIND_KERNEL
    bool "load dtb from boot part but not flash rsv"
    default n

config BL30_SELECT
	string "t6d BL30 board config"
		default "t6d_pxp"

config CMD_PLLTEST
        bool "support plltest command"
        default n
		help
			support plltest command

config AML_REBOOT
		bool "reboot cmd"
		default y
		help
			support uboot reboot cmd
endif
```

## board/amlogic/t6x_skt/Kconfig
```kconfig
if TARGET_T6X_SKT

config SYS_SOC
	default "t6x"

config SYS_BOARD
	default "t6x_skt"

config SYS_CONFIG_NAME
	default "t6x_skt"

config DTB_BIND_KERNEL
    bool "load dtb from boot part but not flash rsv"
    default n

config BL30_SELECT
	string "t6d BL30 board config"
		default "t6d_pxp"

config CMD_PLLTEST
        bool "support plltest command"
        default n
		help
			support plltest command

config AML_REBOOT
		bool "reboot cmd"
		default y
		help
			support uboot reboot cmd
endif
```

## configs/amlogic/s1a_bg209_defconfig
```kconfig
CONFIG_ARM=y
CONFIG_ARCH_MESON=y
CONFIG_SYS_MALLOC_LEN=0x800000
CONFIG_DM_GPIO=y
CONFIG_DEFAULT_DEVICE_TREE="meson-s1a-bg209"
CONFIG_SYS_PROMPT="s1a_bg209# "
CONFIG_MESON_S1A=y
CONFIG_AMLOGIC_MODIFY=y
CONFIG_SECURE_POWER_CONTROL=y
CONFIG_AML_TSENSOR=y
CONFIG_AML_TSENSOR_COOL=y
CONFIG_MULTI_DTB=y
CONFIG_KEY_PRESERVE=y
CONFIG_BL30_SELECT="s1a_bg209"
CONFIG_S1A_BG209=y
CONFIG_DTB_BIND_KERNEL=y
CONFIG_DEBUG_UART_BASE=0xfe07a000
CONFIG_DEBUG_UART_CLOCK=24000000
CONFIG_SYS_MEM_TOP_HIDE=0x400000
CONFIG_DEBUG_UART=y
CONFIG_OF_BOARD_SETUP=y
CONFIG_BOOTCOMMAND="run storeboot"
CONFIG_USE_PREBOOT=y
CONFIG_LOGLEVEL=8
CONFIG_SILENT_CONSOLE=y
# CONFIG_SPL_SILENT_CONSOLE is not set
# CONFIG_TPL_SILENT_CONSOLE is not set
# CONFIG_DISPLAY_CPUINFO is not set
# CONFIG_DISPLAY_BOARDINFO is not set
CONFIG_BOARD_LATE_INIT=y
# CONFIG_CMD_BDI is not set
# CONFIG_BOOTM_PLAN9 is not set
# CONFIG_BOOTM_VXWORKS is not set
# CONFIG_CMD_IMI is not set
# CONFIG_CMD_LZMADEC is not set
# CONFIG_CMD_UNLZ4 is not set
CONFIG_CMD_CLK=y
# CONFIG_CMD_FASTBOOT is not set
CONFIG_CMD_GPIO=y
CONFIG_CMD_I2C=y
# CONFIG_CMD_LOADB is not set
# CONFIG_CMD_LOADS is not set
CONFIG_CMD_MTD=y
CONFIG_CMD_NAND=y
CONFIG_AML_STORAGE=y
CONFIG_CMD_USB=y
CONFIG_CMD_WDT=y
# CONFIG_CMD_SETEXPR is not set
CONFIG_CMD_CACHE=y
CONFIG_CMD_MTDPARTS=y
# CONFIG_CMD_DDR_TEST is not set
CONFIG_CMD_BMP=y
CONFIG_CMD_CLKMSR=y
CONFIG_CMD_SARADC=y
CONFIG_CMD_IR=y
CONFIG_CMD_JTAG=y
CONFIG_CMD_INI=y
CONFIG_AML_PARTITION=y
CONFIG_OF_CONTROL=y
CONFIG_OF_EMBED=y
CONFIG_ENV_SOURCE_FILE="../env/linux"
CONFIG_ENV_IS_IN_STORAGE=y
# CONFIG_NET is not set
CONFIG_EFUSE=y
CONFIG_ADC=y
CONFIG_CLK=y
CONFIG_USB_FUNCTION_FASTBOOT=y
CONFIG_FASTBOOT_FLASH=y
CONFIG_DM_I2C=y
CONFIG_SYS_I2C_MESON=y
CONFIG_LED=y
CONFIG_MISC=y
# CONFIG_MMC is not set
CONFIG_MTD=y
CONFIG_DM_MTD=y
CONFIG_MTD_RAW_NAND=y
CONFIG_SYS_MAX_NAND_DEVICE=2
CONFIG_DM_SPI_FLASH=y
CONFIG_SPI_FLASH_GIGADEVICE=y
CONFIG_SPI_FLASH_WINBOND=y
CONFIG_SPI_FLASH_MTD=y
CONFIG_PHY=y
CONFIG_PINCTRL=y
CONFIG_DM_REGULATOR=y
CONFIG_DM_PWM=y
CONFIG_PWM_MESON=y
CONFIG_DEBUG_UART_ANNOUNCE=y
CONFIG_DEBUG_UART_SKIP_INIT=y
CONFIG_MESON_SERIAL=y
CONFIG_SPI=y
CONFIG_DM_SPI=y
CONFIG_TEE=y
CONFIG_OPTEE=y
CONFIG_USB=y
CONFIG_USB_XHCI_HCD=y
CONFIG_USB_GADGET=y
CONFIG_AML_V3_FACTORY_BURN=y
CONFIG_AML_V3_USB_TOOl=y
# CONFIG_WATCHDOG_AUTOSTART is not set
CONFIG_WDT=y
CONFIG_AML_DRIVER=y
CONFIG_AML_MEDIA=y
CONFIG_AML_VOUT=y
CONFIG_AML_OSD=y
CONFIG_AML_CANVAS=y
CONFIG_AML_DOLBY=y
CONFIG_AML_VPP=y
CONFIG_AML_VPU=y
CONFIG_AML_CVBS=y
CONFIG_AML_HDMITX=y
CONFIG_AML_HDMITX21=y
CONFIG_UNIFY_KEY_MANAGE=y
CONFIG_SECURE_STORAGE=y
CONFIG_AML_FACTORY_PROVISION=y
CONFIG_MESON_LEDS_STATE_CONTROL=y
CONFIG_CMD_LED_DISPLAY=y
CONFIG_MESON_IR=y
CONFIG_PINCTRL_MESON_S1A=y
CONFIG_MTD_SPI_NAND=y
CONFIG_AMLOGIC_USB=y
CONFIG_USB_XHCI_CRG=y
CONFIG_AMLOGIC_USB2_PHY=y
CONFIG_AMLOGIC_USB3_PHY=y
CONFIG_USB_GADGET_CRG=y
CONFIG_WDT_MESON=y
CONFIG_SARADC_MESON_G12A=y
CONFIG_YAFFS2=y
CONFIG_SHA1=y
CONFIG_OF_LIBFDT_OVERLAY=y
CONFIG_LOGLEVEL=8
CONFIG_LMB_MAX_REGIONS=9
CONFIG_ENV_SIZE=0x10000
CONFIG_PARTITION_ENCRYPTION=y
CONFIG_PARTITION_ENCRYPTION_LOCAL=y
CONFIG_AML_MKL=y
CONFIG_ARMV8_CRYPTO=y
CONFIG_AES=y
CONFIG_MD5=y
```

## configs/amlogic/s4_ap222_defconfig
```kconfig
CONFIG_ARM=y
CONFIG_ARCH_MESON=y
CONFIG_TEXT_BASE=0x00000000
CONFIG_MESON_S4=y
CONFIG_ENV_SOURCE_FILE="../env/android_ott"
CONFIG_AML_TSENSOR=y
CONFIG_AML_TSENSOR_COOL=y
CONFIG_BL30_SELECT="s4_ap222"
CONFIG_ENV_IS_IN_STORAGE=y
CONFIG_USE_PREBOOT=y
CONFIG_S4_AP222=y
CONFIG_AMLOGIC_DRIVER=y
CONFIG_AMLOGIC_MODIFY=y
CONFIG_DEBUG_UART_BASE=0xfe07a000
CONFIG_DEBUG_UART_CLOCK=24000000
CONFIG_DEBUG_UART=y
CONFIG_OF_BOARD_SETUP=y
CONFIG_BOOTCOMMAND="run storeboot"
# CONFIG_SILENT_CONSOLE is not set
CONFIG_BOARD_LATE_INIT=y
# CONFIG_DISPLAY_CPUINFO is not set
# CONFIG_DISPLAY_BOARDINFO is not set
CONFIG_SYS_PROMPT="s4_ap222# "
# CONFIG_CMD_BDI is not set
# CONFIG_CMD_DSPSET is not set
# CONFIG_CMD_IMI is not set
CONFIG_CMD_CLK=y
CONFIG_CMD_CLKMSR=y
CONFIG_CMD_GPIO=y
CONFIG_CMD_I2C=y
# CONFIG_CMD_LOADB is not set
# CONFIG_CMD_LOADS is not set
CONFIG_CMD_MMC=y
CONFIG_AMLOGIC_EMMC=y
CONFIG_CMD_MTD=y
CONFIG_AML_STORAGE=y
CONFIG_CMD_PINMUX=y
CONFIG_CMD_USB=y
CONFIG_CMD_SARADC=y
# CONFIG_CMD_SETEXPR is not set
CONFIG_CMD_BMP=y
CONFIG_CMD_CACHE=y
# CONFIG_CMD_MISC is not set
CONFIG_CMD_MTDPARTS=y
CONFIG_CMD_BOOTCTOL_AVB=y
CONFIG_CMD_JTAG=y
CONFIG_CMD_INI=y
CONFIG_CMD_IR=y
CONFIG_AML_PARTITION=y
CONFIG_OF_CONTROL=y
CONFIG_OF_EMBED=y
CONFIG_DEFAULT_DEVICE_TREE="meson-s4-ap222"
CONFIG_ENV_IS_IN_STORAGE=y
CONFIG_ADC=y
CONFIG_SARADC_MESON_G12A=y
CONFIG_CLK=y
CONFIG_CLK_MESON=y
CONFIG_CLK_MESON_S4=y
CONFIG_USB_FUNCTION_FASTBOOT=y
CONFIG_FASTBOOT_FLASH=y
CONFIG_FASTBOOT_DWC_PCD=y
CONFIG_FASTBOOT_FLASH_MMC_DEV=1
CONFIG_DM_GPIO=y
CONFIG_DM_I2C=y
CONFIG_SYS_I2C_MESON=y
CONFIG_MISC=y
CONFIG_DM_MMC=y
CONFIG_MMC_HS200_SUPPORT=y
CONFIG_MMC_MESON_GX=y
CONFIG_DM_MTD=y
CONFIG_MTD=y
CONFIG_NAND=y
CONFIG_MTD_RAW_NAND=y
CONFIG_MESON_NFC=y
CONFIG_SYS_MAX_NAND_DEVICE=2
CONFIG_PHYLIB=y
CONFIG_PHY_AMLOGIC=y
CONFIG_DM_ETH=y
CONFIG_PHY=y
CONFIG_AMLOGIC_ETH=y
CONFIG_AMLOGIC_USB3_PHY=y
CONFIG_AMLOGIC_USB2_PHY=y
CONFIG_PINCTRL=y
CONFIG_PINCONF=y
CONFIG_PINCTRL_MESON_S4=y
CONFIG_DM_REGULATOR=y
CONFIG_DM_PWM=y
CONFIG_PWM_MESON=y
CONFIG_DEBUG_UART_MESON=y
CONFIG_DEBUG_UART_ANNOUNCE=y
CONFIG_DEBUG_UART_SKIP_INIT=y
CONFIG_MESON_SERIAL=y
CONFIG_TEE=y
CONFIG_OPTEE=y
CONFIG_USB=y
CONFIG_DM_USB=y
CONFIG_AMLOGIC_USB=y
CONFIG_USB_XHCI_HCD=y
CONFIG_USB_XHCI_CRG=y
CONFIG_USB_GADGET=y
# CONFIG_DM_USB_GADGET is not set
# CONFIG_USB_GADGET_DWC2_OTG is not set
CONFIG_AML_FACTORY_BURN_LOCAL_UPGRADE=y
CONFIG_AML_V3_FACTORY_BURN=y
CONFIG_AML_V3_USB_TOOl=y
CONFIG_WDT=y
CONFIG_CMD_WDT=y
# CONFIG_WDT_MESON_GXBB is not set
CONFIG_WDT_MESON=y
# CONFIG_WATCHDOG_AUTOSTART is not set
CONFIG_AML_DRIVER=y
CONFIG_AML_MEDIA=y
CONFIG_AML_VOUT=y
CONFIG_AML_OSD=y
CONFIG_AML_CANVAS=y
CONFIG_AML_DOLBY=y
CONFIG_AML_VPP=y
CONFIG_AML_VPU=y
CONFIG_AML_CVBS=y
CONFIG_AML_HDMITX=y
CONFIG_AML_HDMITX20=y
CONFIG_UNIFY_KEY_MANAGE=y
CONFIG_SECURE_STORAGE=y
CONFIG_SECURE_POWER_CONTROL=y
CONFIG_MESON_LEDS_STATE_CONTROL=y
CONFIG_MESON_IR=y
CONFIG_EFUSE=y
CONFIG_IMAGE_CHECK=y
CONFIG_YAFFS2=y
CONFIG_XBC=y
CONFIG_SHA1=y
CONFIG_OF_LIBFDT_OVERLAY=y
CONFIG_AML_FACTORY_PROVISION=y
CONFIG_AML_KASLR_SEED=y
CONFIG_BOOTLOADER_CONTROL_BLOCK=y
CONFIG_CPU_ARMV8=y
CONFIG_UPDATE_MMU_TABLE=y
CONFIG_KEY_PRESERVE=y
CONFIG_NET_MULTI=y
CONFIG_PDVFS_ENABLE=y
CONFIG_NAND_FACTORY_PROVISION=y
CONFIG_AML_CRYPTO=y
CONFIG_AES=y
CONFIG_ARMV8_CRYPTO=y
CONFIG_BOARD_RNG_SEED=y
#CONFIG_HW_RNG_OLD=y
```
